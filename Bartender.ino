#include <Arduboy2.h>
#include <ArdVoice.h>
#include <ArduboyPlaytune.h>
#include "voices.h"
#include "particle.h"

#define dParticleMax 12

Arduboy2 arduboy;
ArdVoice ardvoice;
ArduboyPlaytune tunes(arduboy.audio.enabled);

Particle dotsLanded[dParticleMax];


constexpr uint8_t CowboyWidth = 54;
constexpr uint8_t CowboyHeight = 64;

constexpr uint8_t Cowboy[] PROGMEM
{
  CowboyWidth, CowboyHeight,

  //Frame 0
  0x00, 0x00, 0x00, 0x00, 0x00, 0x00, 0x00, 0xE0, 0x10, 0x08, 0x04, 0x04,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 0x00,
  0x38, 0x44, 0x84, 0x04, 0x04, 0x04, 0x04, 0x07, 0x84, 0x42, 0x22, 0x12,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 0x00,
  0x00, 0x00, 0x00, 0x01, 0x01, 0x01, 0x01, 0xFF, 0x02, 0x0E, 0x05, 0x05,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 0x00,
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  0x00, 0x00, 0x00, 0xE0, 0x1F, 0x00, 0x00, 0x00, 0x00, 0x00, 0x00, 0x01,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 0x80
};

constexpr uint8_t MouthWidth = 5;
constexpr uint8_t MouthHeight = 5;

constexpr uint8_t Mouth[] PROGMEM
{
  MouthWidth, MouthHeight,

  //Frame 0
  0x02, 0x17, 0x17, 0x07, 0x02,

  //Frame 1
  0x02, 0x12, 0x12, 0x02, 0x02,

  //Frame 2
  0x01, 0x09, 0x09, 0x01, 0x01,

  //Frame 3
  0x03, 0x15, 0x15, 0x05, 0x03,

  //Frame 4
  0x04, 0x12, 0x12, 0x02, 0x04
};


constexpr uint8_t GiveWidth = 33;
constexpr uint8_t GiveHeight = 12;

constexpr uint8_t Give[] PROGMEM
{
  GiveWidth, GiveHeight,

  //Frame 0
  0xF0, 0xF8, 0xF8, 0x18, 0x98, 0xB8, 0xB8, 0xB0, 0x00, 0x30, 0xF7, 0xF7,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 0xE0,
  0x07, 0x0F, 0x0F, 0x0C, 0x0D, 0x0F, 0x0F, 0x07, 0x00, 0x00, 0x07, 0x0F,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 0x01
};

constexpr uint8_t MeWidth = 21;
constexpr uint8_t MeHeight = 8;

constexpr uint8_t Me[] PROGMEM
{
  MeWidth, MeHeight,

  //Frame 0
  0x03, 0xFF, 0xFF, 0xFF, 0x03, 0xFE, 0xFF, 0xFF, 0x03, 0xFF, 0xFF, 0xFE, 0x00, 0x7E, 0xFF, 0xFF, 0xDB, 0xDB, 0xDF, 0xDF, 0x1E
};

constexpr uint8_t AWidth = 8;
constexpr uint8_t AHeight = 8;

constexpr uint8_t A[] PROGMEM
{
  AWidth, AHeight,

  //Frame 0
  0x78, 0xFB, 0xFB, 0xDB, 0xDB, 0xFF, 0xFF, 0xFE
};

constexpr uint8_t DrinkWidth = 42;
constexpr uint8_t DrinkHeight = 12;

constexpr uint8_t Drink[] PROGMEM
{
  DrinkWidth, DrinkHeight,

  //Frame 0
  0xE0, 0xF0, 0xF0, 0x30, 0x60, 0xFC, 0xFC, 0xFC, 0x00, 0xF0, 0xF0, 0xF0,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 0x60,
  0x07, 0x0F, 0x0F, 0x0C, 0x0C, 0x0F, 0x0F, 0x0F, 0x00, 0x0F, 0x0F, 0x0F,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 0x0C
};


constexpr uint8_t BartenderWidth = 13;
constexpr uint8_t BartenderHeight = 13;

constexpr uint8_t Bartender[] PROGMEM
{
  BartenderWidth, BartenderHeight,

  //Frame 0
  0x0F, 0xFF, 0xFF, 0xFF, 0xFF, 0xE7, 0xE7, 0xFF, 0xFF, 0xFE, 0xFC, 0x98, 0x00,
  0x1E, 0x1F, 0x1F, 0x1F, 0x1F, 0x1C, 0x1C, 0x1E, 0x1F, 0x1F, 0x1F, 0x0F, 0x07,

  //Frame 1
  0x00, 0x00, 0xC0, 0xF8, 0xFF, 0xFF, 0x1F, 0xFF, 0xFF, 0xF8, 0xC0, 0x00, 0x00,
  0x18, 0x1E, 0x1F, 0x1F, 0x1F, 0x07, 0x07, 0x07, 0x1F, 0x1F, 0x1F, 0x1E, 0x18,

  //Frame 2
  0x0F, 0xFF, 0xFF, 0xFF, 0xFF, 0xC7, 0xC7, 0xEF, 0xFF, 0xFE, 0xFE, 0x7C, 0x38,
  0x1E, 0x1F, 0x1F, 0x1F, 0x1F, 0x01, 0x03, 0x07, 0x1F, 0x1F, 0x1E, 0x0E, 0x0C,

  //Frame 3
  0x0F, 0x0F, 0x0F, 0x07, 0xFF, 0xFF, 0xFF, 0xFF, 0x07, 0x0F, 0x0F, 0x0F, 0x00,
  0x00, 0x00, 0x00, 0x1E, 0x1F, 0x1F, 0x1F, 0x1F, 0x1E, 0x00, 0x00, 0x00, 0x00,

  //Frame 4
  0x0F, 0xFF, 0xFF, 0xFF, 0xFF, 0xE7, 0xE7, 0xE7, 0x0F, 0x0F, 0x0F, 0x0C, 0x00,
  0x1E, 0x1F, 0x1F, 0x1F, 0x1F, 0x1C, 0x1C, 0x1C, 0x1E, 0x1E, 0x1E, 0x0E, 0x00,

  //Frame 5
  0x0F, 0xFF, 0xFF, 0xFF, 0xFF, 0xFC, 0xF8, 0xE0, 0xFF, 0xFF, 0xFF, 0xFF, 0x0F,
  0x1E, 0x1F, 0x1F, 0x1F, 0x1F, 0x00, 0x03, 0x07, 0x1F, 0x1F, 0x1F, 0x1F, 0x1E,

  //Frame 6
  0x0F, 0xFF, 0xFF, 0xFF, 0xFF, 0x07, 0x0F, 0x1F, 0xFE, 0xFE, 0xFC, 0xF0, 0x00,
  0x1E, 0x1F, 0x1F, 0x1F, 0x1F, 0x1C, 0x1E, 0x1F, 0x0F, 0x0F, 0x07, 0x01, 0x00,

  //Frame 7
  0x0F, 0xFF, 0xFF, 0xFF, 0xFF, 0xE7, 0xE7, 0xE7, 0x0F, 0x0F, 0x0F, 0x0C, 0x00,
  0x1E, 0x1F, 0x1F, 0x1F, 0x1F, 0x1C, 0x1C, 0x1C, 0x1E, 0x1E, 0x1E, 0x0E, 0x00,

  //Frame 8
  0x0F, 0xFF, 0xFF, 0xFF, 0xFF, 0xC7, 0xC7, 0xEF, 0xFF, 0xFE, 0xFE, 0x7C, 0x38,
  0x1E, 0x1F, 0x1F, 0x1F, 0x1F, 0x01, 0x03, 0x07, 0x1F, 0x1F, 0x1E, 0x0E, 0x0C
};


constexpr uint8_t SquintWidth = 128;
constexpr uint8_t SquintHeight = 42;

constexpr uint8_t Squint[] PROGMEM
{
  SquintWidth, SquintHeight,

  //Frame 0
  0x0F, 0xF3, 0x1F, 0x0D, 0x1D, 0x3F, 0x26, 0x0B, 0x0F, 0x07, 0x07, 0x03,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 0x00,
  0x01, 0x01, 0x40, 0x80, 0xA0, 0x80, 0x90, 0x80, 0x88, 0x88, 0x80, 0x84,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 0x00,
  0xFE, 0xFF, 0xFF, 0xFF, 0xFF, 0xFF, 0xFF, 0xFF, 0xFF, 0xFF, 0xFF, 0xFF,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 0x00,
  0x09, 0x13, 0x07, 0x2F, 0x0F, 0x1F, 0x1F, 0xBF, 0xBF, 0x3F, 0x3F, 0x7F,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 0x00,
  0x00, 0x04, 0x00, 0x00, 0x10, 0x20, 0x20, 0x00, 0x00, 0x00, 0x01, 0x41,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 0x00,
  0x00, 0x00, 0x00, 0x00, 0x00, 0x00, 0x00, 0x00, 0x00, 0x00, 0x00, 0x00,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 0x00,

  //Frame 1
  0x0F, 0xF3, 0x1F, 0x0D, 0x1D, 0x3F, 0x26, 0x0B, 0x0F, 0x07, 0x07, 0x03,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 0x00,
  0x01, 0x01, 0x00, 0x00, 0x00, 0x00, 0x40, 0x00, 0x20, 0x20, 0x00, 0x10,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 0x00,
  0xFE, 0xFE, 0xFE, 0xFF, 0xFF, 0xFF, 0xFF, 0xFF, 0xFF, 0xFF, 0xFF, 0xFF,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 0x00,
  0x01, 0x03, 0x03, 0x07, 0x07, 0x0F, 0x0F, 0x1F, 0x1F, 0x1F, 0x3F, 0x3F,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 0x00,
  0x00, 0x01, 0x00, 0x00, 0x04, 0x08, 0x08, 0x00, 0x00, 0x00, 0x00, 0x10,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 0x00,
  0x00, 0x00, 0x00, 0x00, 0x00, 0x00, 0x00, 0x00, 0x00, 0x00, 0x00, 0x00,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 0x00,

  //Frame 2
  0x0F, 0xF3, 0x1F, 0x0D, 0x1D, 0x3F, 0x26, 0x0B, 0x0F, 0x07, 0x07, 0x03,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 0x00,
  0x01, 0x01, 0x00, 0x00, 0x00, 0x00, 0x80, 0x00, 0x40, 0x40, 0x00, 0x20,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 0x00,
  0xFC, 0xFC, 0xFC, 0xFC, 0xFE, 0xFE, 0xFE, 0xFE, 0xFE, 0xFE, 0xFE, 0xFE,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 0x00,
  0x00, 0x81, 0x01, 0x03, 0x03, 0x07, 0x07, 0x17, 0x17, 0x1F, 0x3F, 0x2F,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 0x00,
  0x00, 0x00, 0x00, 0x00, 0x02, 0x04, 0x04, 0x00, 0x00, 0x00, 0x00, 0x08,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 0x00,
  0x00, 0x00, 0x00, 0x00, 0x00, 0x00, 0x00, 0x00, 0x00, 0x00, 0x00, 0x00,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 0x00,

  //Frame 3
  0x0F, 0xF3, 0x1F, 0x0D, 0x1D, 0x3F, 0x26, 0x0B, 0x0F, 0x07, 0x07, 0x03,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 0x00,
  0x01, 0x01, 0x00, 0x00, 0x00, 0x00, 0x80, 0x00, 0x80, 0x80, 0x00, 0x40,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 0x00,
  0x30, 0x78, 0x78, 0x78, 0xFC, 0xFC, 0xFC, 0xFC, 0xFC, 0xFC, 0xFC, 0xFC,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 0x00,
  0x00, 0x40, 0x00, 0x00, 0x00, 0x01, 0x01, 0x03, 0x03, 0x03, 0x07, 0x07,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 0x00,
  0x00, 0x00, 0x00, 0x00, 0x01, 0x02, 0x02, 0x00, 0x00, 0x00, 0x00, 0x04,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 0x00,
  0x00, 0x00, 0x00, 0x00, 0x00, 0x00, 0x00, 0x00, 0x00, 0x00, 0x00, 0x00,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 0x00
};

constexpr uint8_t TenderWidth = 52;
constexpr uint8_t TenderHeight = 63;

constexpr uint8_t Tender[] PROGMEM
{
  TenderWidth, TenderHeight,

  //Frame 0
  0x00, 0x00, 0x00, 0x00, 0x00, 0x00, 0x00, 0x00, 0x00, 0x00, 0x00, 0x00,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 0x00,
  0x00, 0x00, 0x00, 0x00, 0x00, 0x00, 0x00, 0x00, 0x00, 0x00, 0x00, 0x00,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 0x00,
  0x00, 0x00, 0x00, 0x00, 0x00, 0x00, 0x00, 0x00, 0x00, 0x00, 0x00, 0x00,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 0x00,
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  0x00, 0x00, 0x00, 0x00, 0x00, 0x00, 0x00, 0x00, 0x00, 0x78, 0x07, 0x00,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 0x00
};

constexpr uint8_t EyesWidth = 14;
constexpr uint8_t EyesHeight = 7;

constexpr uint8_t Eyes[] PROGMEM
{
  EyesWidth, EyesHeight,

  //Frame 0
  0x34, 0x7A, 0x4A, 0x59, 0x7B, 0x32, 0x00, 0x00, 0x30, 0x7C, 0x5C, 0x4A, 0x7A, 0x30,

  //Frame 1
  0x34, 0x52, 0x52, 0x72, 0x76, 0x34, 0x00, 0x00, 0x34, 0x54, 0x52, 0x72, 0x72, 0x30,

  //Frame 2
  0x34, 0x54, 0x54, 0x7C, 0x78, 0x30, 0x00, 0x00, 0x38, 0x58, 0x54, 0x74, 0x74, 0x30,

  //Frame 3
  0x34, 0x72, 0x52, 0x71, 0x73, 0x32, 0x00, 0x00, 0x38, 0x78, 0x54, 0x74, 0x72, 0x32,

  //Frame 4
  0x34, 0x72, 0x52, 0x51, 0x73, 0x32, 0x00, 0x00, 0x34, 0x74, 0x52, 0x52, 0x71, 0x31
};


constexpr uint8_t Arm1Width = 27;
constexpr uint8_t Arm1Height = 17;

constexpr uint8_t Arm1[] PROGMEM
{
  Arm1Width, Arm1Height,

  //Frame 0
  0x00, 0x00, 0xC0, 0x20, 0x10, 0x10, 0x10, 0x20, 0xD0, 0x10, 0x08, 0x08, 0x08, 0x04, 0x04, 0x02, 0x01, 0x00, 0x00, 0x00, 0x00, 0x00, 0x00, 0x00, 0x00, 0x00, 0x00,
  0x78, 0x87, 0x44, 0x01, 0x00, 0x00, 0x00, 0x00, 0x03, 0x0C, 0x70, 0x80, 0x00, 0x80, 0x40, 0x40, 0x40, 0x40, 0x40, 0x20, 0x30, 0x28, 0x20, 0x20, 0x10, 0x10, 0x08,
  0x00, 0x01, 0x00, 0x00, 0x00, 0x00, 0x00, 0x00, 0x00, 0x00, 0x00, 0x01, 0x01, 0x00, 0x00, 0x00, 0x00, 0x00, 0x00, 0x00, 0x00, 0x00, 0x00, 0x00, 0x00, 0x00, 0x00
};

constexpr uint8_t Arm2Width = 23;
constexpr uint8_t Arm2Height = 13;

constexpr uint8_t Arm2[] PROGMEM
{
  Arm2Width, Arm2Height,

  //Frame 0
  0x30, 0xCC, 0x02, 0x01, 0x01, 0x00, 0x02, 0x00, 0x04, 0x08, 0x08, 0x08, 0x08, 0x00, 0x08, 0x10, 0x20, 0x40, 0x80, 0x00, 0x00, 0x00, 0x00,
  0x00, 0x01, 0x02, 0x04, 0x08, 0x10, 0x00, 0x00, 0x10, 0x00, 0x10, 0x08, 0x00, 0x08, 0x04, 0x02, 0x01, 0x01, 0x00, 0x01, 0x02, 0x04, 0x18
};

constexpr uint8_t Arm3Width = 27;
constexpr uint8_t Arm3Height = 14;

constexpr uint8_t Arm3[] PROGMEM
{
  Arm3Width, Arm3Height,

  //Frame 0
  0x3C, 0x42, 0x80, 0x01, 0x00, 0x02, 0x00, 0x04, 0x04, 0x04, 0x04, 0x04, 0x00, 0x02, 0x02, 0x04, 0x04, 0xF8, 0x04, 0x02, 0x02, 0x0A, 0x04, 0x08, 0x00, 0x90, 0x60,
  0x00, 0x00, 0x01, 0x02, 0x04, 0x08, 0x10, 0x10, 0x20, 0x00, 0x20, 0x00, 0x00, 0x20, 0x10, 0x10, 0x08, 0x07, 0x08, 0x10, 0x10, 0x10, 0x10, 0x08, 0x00, 0x02, 0x01
};

constexpr uint8_t BeerWidth = 15;
constexpr uint8_t BeerHeight = 25;

constexpr uint8_t Beer[] PROGMEM
{
  BeerWidth, BeerHeight,

  //Frame 0
  0xFC, 0xFC, 0x0A, 0xFE, 0x0A, 0xFE, 0x91, 0xFF, 0x15, 0xFF, 0x15, 0xFF, 0x11, 0xFF, 0x15, 0xFF, 0x11, 0xFF, 0x11, 0xFF, 0x11, 0xFF, 0x11, 0xFF, 0x0A, 0xFE, 0x0A, 0xFE, 0xFC, 0xFC,
  0x03, 0x03, 0x7C, 0x7F, 0x80, 0xFF, 0x01, 0xFF, 0x3C, 0xFF, 0x80, 0xFF, 0x00, 0xFF, 0x00, 0xFF, 0x00, 0xFF, 0x00, 0xFF, 0x20, 0xFF, 0x01, 0xFF, 0x80, 0xFF, 0x7C, 0x7F, 0x03, 0x03,
  0x00, 0x00, 0x00, 0x00, 0xFF, 0xFF, 0x80, 0xFF, 0x00, 0xFF, 0x2F, 0xFF, 0x00, 0xFF, 0x00, 0xFF, 0x00, 0xFF, 0x20, 0xFF, 0x00, 0xFF, 0x80, 0xFF, 0xFF, 0xFF, 0x00, 0x00, 0x00, 0x00,
  0x00, 0x00, 0x00, 0x00, 0x00, 0x00, 0x00, 0x00, 0x01, 0x01, 0x01, 0x01, 0x01, 0x01, 0x01, 0x01, 0x01, 0x01, 0x01, 0x01, 0x01, 0x01, 0x00, 0x00, 0x00, 0x00, 0x00, 0x00, 0x00, 0x00
};

constexpr uint8_t HandWidth = 31;
constexpr uint8_t HandHeight = 22;

constexpr uint8_t Hand[] PROGMEM
{
  HandWidth, HandHeight,

  //Frame 0
  0x30, 0x30, 0xC8, 0xF8, 0x04, 0xFC, 0x24, 0xFC, 0x98, 0xF8, 0x20, 0xE0,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 0x00,
  0x00, 0x00, 0x06, 0x06, 0x09, 0x0F, 0x08, 0x0F, 0x0A, 0x0F, 0x04, 0x07,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 0x00,
  0x00, 0x00, 0x00, 0x00, 0x00, 0x00, 0x00, 0x00, 0x00, 0x00, 0x00, 0x00,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 0x20
};

constexpr uint8_t BrokenWidth = 66;
constexpr uint8_t BrokenHeight = 13;

constexpr uint8_t Broken[] PROGMEM
{
  BrokenWidth, BrokenHeight,

  //Frame 0
  0x00, 0x00, 0x00, 0x00, 0x00, 0x00, 0x00, 0x80, 0x00, 0x00, 0x00, 0x00,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 0x00,
  0x04, 0x00, 0x00, 0x00, 0x02, 0x03, 0x05, 0x05, 0x05, 0x05, 0x05, 0x05,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 0x01
};


constexpr uint8_t CheersWidth = 12;
constexpr uint8_t CheersHeight = 13;

constexpr uint8_t Cheers[] PROGMEM
{
  CheersWidth, CheersHeight,

  //Frame 0
  0xE0, 0xF8, 0xFC, 0xFE, 0x1E, 0x0F, 0x07, 0x07, 0x0F, 0x0F, 0x0F, 0x0C,
  0x00, 0x03, 0x07, 0x0F, 0x0F, 0x1E, 0x1C, 0x1C, 0x1E, 0x1E, 0x1E, 0x06,

  //Frame 1
  0x0F, 0xFF, 0xFF, 0xFF, 0xFF, 0xE0, 0xE0, 0xE0, 0xFF, 0xFF, 0xFF, 0xFF,
  0x1E, 0x1F, 0x1F, 0x1F, 0x1F, 0x00, 0x00, 0x00, 0x1F, 0x1F, 0x1F, 0x1F,

  //Frame 2
  0x0F, 0xFF, 0xFF, 0xFF, 0xFF, 0xE7, 0xE7, 0xE7, 0x0F, 0x0F, 0x0F, 0x0C,
  0x1E, 0x1F, 0x1F, 0x1F, 0x1F, 0x1C, 0x1C, 0x1C, 0x1E, 0x1E, 0x1E, 0x0E,

  //Frame 3
  0x0F, 0xFF, 0xFF, 0xFF, 0xFF, 0xE7, 0xE7, 0xE7, 0x0F, 0x0F, 0x0F, 0x0C,
  0x1E, 0x1F, 0x1F, 0x1F, 0x1F, 0x1C, 0x1C, 0x1C, 0x1E, 0x1E, 0x1E, 0x0E,

  //Frame 4
  0x0F, 0xFF, 0xFF, 0xFF, 0xFF, 0xC7, 0xC7, 0xEF, 0xFF, 0xFE, 0xFE, 0x7C,
  0x1E, 0x1F, 0x1F, 0x1F, 0x1F, 0x01, 0x03, 0x07, 0x1F, 0x1F, 0x1E, 0x0E,

  //Frame 5
  0x38, 0x7C, 0x7E, 0xFE, 0xFF, 0xF7, 0xE7, 0xE7, 0xEF, 0xCF, 0xCF, 0x8C,
  0x06, 0x1E, 0x1E, 0x1E, 0x1C, 0x1C, 0x1D, 0x1F, 0x0F, 0x0F, 0x07, 0x03
};



int mouthTick = 0;
int mouthStep = 0;
int mouthFrame = 1;

int mouthFrames[] = { 0, 1 , 2, 0, 2, 1, 0, 2, 0, 1 };


int talkDuration = 0;

bool hasSpoken = 0;

float cursorY[9] = {};
float animationSpeed = 0.01;

int gameMode = 1;

int startMillis = 0;

int squintTick = 0;
int squintFrame = 0;

int tenderX = 45;
int tenderY = 1;

int tenderTick = 0;
int tenderFrame = 0;

int beerX = 26;
float beerV = 0;

bool beerCaught = 0;

int duration = 0;


void updateDots() {
  for ( int i = 0; i < dParticleMax; i++) {
    dotsLanded[i].update();
    if ( dotsLanded[i].render() ) {                                                             // the dot should be rendered
      int pSize = dotsLanded[i].getSize();
      if ( dotsLanded[i].getType() == 2) {
        arduboy.setCursor( dotsLanded[i].getX(), dotsLanded[i].getY() );
        //strcpy_P(buffer, (char *)pgm_read_word(&(goodWords[ dotsLanded[i].getWord() ])));
        //arduboy.print(buffer);
        arduboy.print("!");
      }
      else if ( dotsLanded[i].getType() == 3) {
        arduboy.setCursor( dotsLanded[i].getX(), dotsLanded[i].getY() );
        //arduboy.print( dotsLanded[i].getWord() );
      } else {
        if ( pSize == 1 ) {
          arduboy.drawPixel( dotsLanded[i].getX(), dotsLanded[i].getY(), 1);
        } else {
          arduboy.drawRect( dotsLanded[i].getX(), dotsLanded[i].getY(), pSize, pSize, 1);
        }
      }
    }
  }
}






void setup() {
  arduboy.beginDoFirst();
  arduboy.setFrameRate(60);
  arduboy.audio.on();

  tunes.initChannel(PIN_SPEAKER_1);
  tunes.initChannel(PIN_SPEAKER_2);

}


void loop() {
  if (!(arduboy.nextFrame()))
    return;

  if (gameMode == 1) {
    arduboy.clear();
    Sprites::drawOverwrite(73, 0, Cowboy, 0);
    arduboy.display();
    if (arduboy.pressed(A_BUTTON) || arduboy.pressed(B_BUTTON)) {
      ardvoice.playVoice(merry_q6);
      talkDuration = 13;
      hasSpoken = 0;
      gameMode = 2;
      startMillis = millis();
    }

  }
  else if (gameMode == 2) {
    arduboy.clear();
    Sprites::drawOverwrite(73, 0, Cowboy, 0);

    duration++;

    if (talkDuration > 1) {
      Sprites::drawSelfMasked(5, 8, Give, 0);
      if (talkDuration < 13) Sprites::drawSelfMasked(44, 12, Me, 0);
      if (talkDuration < 12) Sprites::drawSelfMasked(7, 29, A, 0);
      if (talkDuration < 10) Sprites::drawSelfMasked(21, 25, Drink, 0);

      if (talkDuration < 6) {
        for (int i = 0; i < 3; i++) {
          cursorY[i] = 6 * sin((millis() + (i * 24)) * animationSpeed);
          Sprites::drawSelfMasked(i * 14 + 2, cursorY[i] + 45, Bartender, i);
        }
      }

      if (talkDuration < 4) {
        for (int i = 0; i < 9; i++) {
          cursorY[i] = 6 * sin((millis() + (i * 24)) * animationSpeed);
          Sprites::drawSelfMasked(i * 14 + 2, cursorY[i] + 45, Bartender, i);
        }
      }

      mouthTick++;
      if (mouthTick > 10) {
        talkDuration--;
        mouthTick = 0;

        mouthFrame = mouthFrames[mouthStep];
        mouthStep++;
        if (mouthStep > 9) mouthStep = 0;
      }
    }
    if (talkDuration == 1) {
      hasSpoken = 1;
      talkDuration--;
    }
    else if (talkDuration == 0) {
      mouthTick = 0;
      mouthStep = 0;
      mouthFrame = 1;
    }

    if (hasSpoken) {
      Sprites::drawSelfMasked(5, 8, Give, 0);
      Sprites::drawSelfMasked(44, 12, Me, 0);
      Sprites::drawSelfMasked(7, 29, A, 0);
      Sprites::drawSelfMasked(21, 25, Drink, 0);
      for (int i = 0; i < 9; i++) {
        cursorY[i] = 6 * sin((millis() + (i * 24)) * animationSpeed);
        Sprites::drawSelfMasked(i * 14 + 2, cursorY[i] + 45, Bartender, i);
      }
    }

    Sprites::drawOverwrite(86, 27, Mouth, mouthFrame);


    arduboy.display();

    if (duration > 300) {
      duration = 0;
      gameMode = 3;
    }

  }
  else if (gameMode == 3) {

    for (int i = 0; i < 2; i++) {
      arduboy.fillRect(0, 0, 127, 63, 1);
      arduboy.display();
      delay(50);
      arduboy.clear();
      arduboy.display();
      delay(50);
    }
    for (int i = 0; i < 127; i++) {
      arduboy.drawLine(0, 31, i, 31, 1);
      arduboy.display();
    }
    for (int i = 0; i < 21; i++) {
      arduboy.clear();
      Sprites::drawOverwrite(1, 12, Squint, 0);
      arduboy.fillRect(0, 0, 127, 32 - i, 0);
      arduboy.fillRect(0, 34 + i, 127, 34 - i, 0);
      arduboy.drawLine(0, 32 - i, 127, 32 - i, 1);
      arduboy.drawLine(0, 34 + i, 127, 34 + i, 1);
      arduboy.display();
    }

    startMillis = millis();

    gameMode = 4;
  }
  else if (gameMode == 4) {
    arduboy.clear();

    duration++;

    Sprites::drawOverwrite(1, 12, Squint, squintFrame);
    arduboy.drawLine(0, 11, 127, 11, 1);
    arduboy.drawLine(0, 54, 127, 54, 1);
    if (squintFrame < 3) {
      squintTick++;
      if (squintTick > 30) {
        squintTick = 0;
        squintFrame++;
      }
    }

    arduboy.display();

    if (duration > 200) {
      duration = 0;
      squintFrame = 0;
      gameMode = 5;
    }

  }
  else if (gameMode == 5) {




    for (int i = 21; i > 0; i -= 2) {
      arduboy.clear();
      Sprites::drawOverwrite(1, 12, Squint, 3);
      arduboy.fillRect(0, 0, 127, 32 - i, 0);
      arduboy.fillRect(0, 34 + i, 127, 34 - i, 0);
      arduboy.drawLine(0, 32 - i, 127, 32 - i, 1);
      arduboy.drawLine(0, 33 + i, 127, 33 + i, 1);
      arduboy.display();
    }
    for (int i = 0; i < 127; i++) {
      arduboy.clear();
      arduboy.drawLine(i, 31, 127, 31, 1);
      arduboy.display();
    }

    gameMode = 6;



  }
  else if (gameMode == 6) {

    tenderTick++;
    if (tenderTick > 20) {
      tenderTick = 0;
      tenderFrame++;
      if (tenderFrame == 5 || tenderFrame == 6) {
        tenderX++;
      }
      if (tenderFrame > 8) {
        tenderFrame = 0;
        tenderX = 45;
        beerX = 26;
        beerV = 0;
        gameMode = 7;
      }
    }
    arduboy.clear();

    Sprites::drawOverwrite(tenderX, tenderY, Tender, 0);

    if (tenderFrame < 2) {
      Sprites::drawOverwrite(tenderX - 17, tenderY + 46, Arm1, 0);
      Sprites::drawOverwrite(tenderX + 19, tenderY + 7, Eyes, 0);
    }
    else if (tenderFrame == 2) {
      Sprites::drawOverwrite(tenderX - 17, tenderY + 46, Arm1, 0);
      Sprites::drawOverwrite(tenderX + 19, tenderY + 7, Eyes, 1);
    }
    else if (tenderFrame == 3) {
      Sprites::drawOverwrite(tenderX - 17, tenderY + 46, Arm1, 0);
      Sprites::drawOverwrite(tenderX + 19, tenderY + 7, Eyes, 2);
    }
    else if (tenderFrame == 4) {
      Sprites::drawOverwrite(tenderX - 17, tenderY + 46, Arm1, 0);
      Sprites::drawOverwrite(tenderX + 19, tenderY + 7, Eyes, 3);
    }
    else if (tenderFrame == 5) {
      Sprites::drawOverwrite(tenderX - 3, tenderY + 50, Arm2, 0);
      Sprites::drawOverwrite(tenderX + 19, tenderY + 7, Eyes, 0);
    }
    else if (tenderFrame > 5) {
      Sprites::drawOverwrite(tenderX - 3, tenderY + 50, Arm3, 0);
      Sprites::drawOverwrite(tenderX + 19, tenderY + 7, Eyes, 4);
    }

    if (tenderFrame >= 4) {

      beerV += (0.05 + beerV / 32);
      beerX += beerV;
    }
    Sprites::drawPlusMask(beerX, 39, Beer, 0);




    arduboy.display();
  }
  else if (gameMode == 7) {
    //beer slide
    ardvoice.playVoice(woosh);

    for (int i = -16; i < 132; i++) {
      arduboy.pollButtons();
      arduboy.clear();
      Sprites::drawPlusMask(i, 24, Beer, 0);
      if (i % 10 == 0) {
        drawSlide(i);
      }
      updateDots();
      delay(5);
      if (i > 0 && i < 100 && !beerCaught) {
        if (arduboy.justPressed(A_BUTTON) || arduboy.justPressed(B_BUTTON)) {
          arduboy.fillRect(0, 0, 127, 63, 1);
          beerCaught = 1;
        }
      }
      arduboy.display();
    }

    if (beerCaught) {
      beerCaught = 0;
      gameMode = 8;
    }
    else {
      beerCaught = 0;
      gameMode = 9;
    }

  }
  else if (gameMode == 8) {
    TCCR4A = 2;
    TCCR4B = 7;
    OCR4C = 255;
    OCR4A = 0;
    tunes.playScore(fanfare);

    for (int i = 0; i < 3; i++) {
      arduboy.clear();
      Sprites::drawPlusMask(41, 35 - i, Beer, 0);
      Sprites::drawPlusMask(41, 45 - i, Hand, 0);
      Sprites::drawOverwrite(73, 0, Cowboy, 0);
      Sprites::drawOverwrite(86, 26, Mouth, 3);
      arduboy.display();
      delay(100);

    }




    do {

      if ((arduboy.nextFrame())) {

        arduboy.clear();
        Sprites::drawPlusMask(41, 32, Beer, 0);
        Sprites::drawPlusMask(41, 42, Hand, 0);
        Sprites::drawOverwrite(73, 0, Cowboy, 0);
        Sprites::drawOverwrite(86, 26, Mouth, 3);
        for (int i = 0; i < 6; i++) {



          cursorY[i] = 6 * sin((millis() + (i * 24)) * animationSpeed);
          Sprites::drawSelfMasked(i * 14 + 2, cursorY[i] + 12, Cheers, i);

        }
        arduboy.display();
      }
    } while (!(arduboy.pressed(A_BUTTON) || arduboy.pressed(B_BUTTON)));

    for (int i = 0; i < 30; i++) {
      arduboy.clear();
      Sprites::drawPlusMask(41, 32 + i, Beer, 0);
      Sprites::drawPlusMask(41, 42 + i, Hand, 0);
      Sprites::drawOverwrite(73, 0, Cowboy, 0);
      Sprites::drawOverwrite(86, 26, Mouth, 3);
      arduboy.display();
      delay(10);

    }

    gameMode = 1;
  }
  else if (gameMode == 9) {
    ardvoice.playVoice(crash);




    drawCrashed();
    for (int i = 0; i < 3; i++) {
      arduboy.clear();
      Sprites::drawOverwrite(6, 51 - i, Broken, 0);
      Sprites::drawOverwrite(73, 0, Cowboy, 0);
      Sprites::drawOverwrite(86, 26, Mouth, 4);
      updateDots();
      arduboy.display();
      delay(10);

    }





    do {
      arduboy.clear();
      Sprites::drawOverwrite(6, 48, Broken, 0);
      Sprites::drawOverwrite(73, 0, Cowboy, 0);
      Sprites::drawOverwrite(86, 26, Mouth, 4);
      updateDots();
      delay(10);
      arduboy.display();
    } while (!(arduboy.pressed(A_BUTTON) || arduboy.pressed(B_BUTTON)));


    for (int i = 0; i < 30; i++) {
      arduboy.clear();

      Sprites::drawOverwrite(6, 48 + i, Broken, 0);
      Sprites::drawOverwrite(73, 0, Cowboy, 0);
      Sprites::drawOverwrite(86, 26, Mouth, 4);
      arduboy.display();
      delay(10);

    }


    gameMode = 1;
  }


}

void drawCrashed() {
  for ( int i = 0; i < dParticleMax; i++) {
    dotsLanded[i].setX( random(50) + 12 );
    dotsLanded[i].setY(  random(12) + 52 );
    dotsLanded[i].setVelX( random(-4, 12) );
    dotsLanded[i].setVelY( random(6));
    dotsLanded[i].setCounter( random(10, 66) );
    dotsLanded[i].setSize( random(1, 5) );
    dotsLanded[i].setType( 0 );
  }
}

int beerSuds = 0;

void drawSlide(int beerLoc) {

  beerSuds++;
  if (beerSuds > 10) {
    beerSuds = 0;
  }
  int z = beerSuds;
  dotsLanded[z].setX( beerLoc + 10 + random(5) );
  dotsLanded[z].setY(  44 + random(4) );
  dotsLanded[z].setVelX( random(-6, -4) );
  dotsLanded[z].setVelY( random(2) + 1);
  dotsLanded[z].setCounter( random(5, 12) );
  dotsLanded[z].setSize( random(1, 3) );
  dotsLanded[z].setType( 0 );

}
